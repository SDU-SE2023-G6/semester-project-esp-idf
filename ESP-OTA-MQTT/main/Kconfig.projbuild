## ESP-OTA-MQTT/main/Kconfig.projbuild
```kconfig
menu "Example Configuration"

    config WIFI_SSID
        string "WiFi SSID"
        default "ESP Friendly"
    
    config WIFI_PASS
        string "WiFi Password"
        default "alleskaldoe"

    config EXAMPLE_FIRMWARE_UPGRADE_URL
        string "Firmware Upgrade URL"
        default "https://192.168.2.106:8070/hello_world.bin"
        help
            URL of server which hosts the firmware image.

    config EXAMPLE_FIRMWARE_UPGRADE_URL_FROM_STDIN
        bool
        default y if EXAMPLE_FIRMWARE_UPGRADE_URL = "FROM_STDIN"

    config EXAMPLE_SKIP_COMMON_NAME_CHECK
        bool "Skip server certificate CN fieldcheck"
        default n
        help
            This allows you to skip the validation of OTA server certificate CN field.

    config EXAMPLE_SKIP_VERSION_CHECK
        bool "Skip firmware version check"
        default n
        help
            This allows you to skip the firmware version check.

    config EXAMPLE_OTA_RECV_TIMEOUT
        int "OTA Receive Timeout"
        default 5000
        help
            Maximum time for reception

    config EXAMPLE_ENABLE_PARTIAL_HTTP_DOWNLOAD
        bool "Enable partial HTTP download"
        default n
        help
            This enables use of Range header in esp_https_ota component.
            Firmware image will be downloaded over multiple HTTP requests.

    config EXAMPLE_HTTP_REQUEST_SIZE
        int "HTTP request size"
        default MBEDTLS_SSL_IN_CONTENT_LEN
        depends on EXAMPLE_ENABLE_PARTIAL_HTTP_DOWNLOAD
        help
            This options specifies HTTP request size. Number of bytes specified
            in this option will be downloaded in single HTTP request.

    config BROKER_URL
        string "Broker URL"
        default "mqtt://localhost:1883"
        help
            URL of the MQTT broker.
    config SERVER_URL
        string "Server URL"
        default "http://localhost:8080"
        help 
            URL of the backend server. Should not end in a backslash.

    config ESP_INITIAL
        bool "Initialize WiFi"
        default y
        help
            Is it the initial image.
endmenu



config EXAMPLE_WIFI_SSID
    string "Example WiFi SSID"
    default WIFI_SSID

config EXAMPLE_WIFI_PASSWORD
    string "Example WiFi Password"
    default WIFI_PASS
```
